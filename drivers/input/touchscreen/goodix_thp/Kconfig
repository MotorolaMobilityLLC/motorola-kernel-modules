## drivers/input/touchscreen/goodix_thp/Kconfig
```kconfig
#
# Goodix touchscreen driver configuration
#
menuconfig TOUCHSCREEN_GOODIX_BRL_THP
        tristate "Goodix berlin touchscreen"
        default n
        help
          Say Y here if you have a Goodix berlin touch controller
          to your system.

config THP_FOLD
    bool "Enable thp fold gesture"
    help
      Say Y here if support thp fold gesture

config TOUCHCLASS_MMI_FORCE_ENTER_STANDBY
    bool "Enable force enter standby mode"
    help
      Say Y here if support force enter standby mode

config TOUCHCLASS_MMI_FORCE_ENABLE_GESTURES
    bool "Enable force enable or disable specified gesture mode"
    help
      Say Y here to allow gesture modes, like zero-tap, to be enabled or disabled
      via a special command even when the touch controller is in a suspend/gesture
      state. This is needed to fix issues where gestures are not correctly re-enabled
      after exiting certain power states.

config HIGH_REPORT_RATE_FOLLOWS_SWIPE_RESPONSIVENESS
    bool "Enable switch touch report rate followed by swipe responsiveness"
    help
      Say Y here to enable switch touch report rate followed by swipe responsiveness

config TPIC_CHIP_TYPE_9926
    bool "Enable it to select GT9926 touch IC"
    help
      Say Y here to select GT9926 touch IC

config SPECIFY_CORNER_SUPPRESSION_TYPE
        bool "Enable Specified Corner Suppression Type from device tree"
        default n
        help
          Say Y here if the product supports custom corner suppression types
          read from the device tree 'goodix,edge-ctrl-type' property.
```
