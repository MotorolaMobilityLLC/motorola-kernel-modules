## Documentation/devicetree/bindings/input/misc/mmi_earbud_chg_v2/mmi_earbud_chg_v2.txt
```
MMI earbud V2 is advanced version of V1
modified V1 to adopt V2

v1:
 Read ADC data from PM gpio line..
 No support to control buds using UART
 GPIO's are direct Base charging enable/disable
 HALL sensor to detect lip Open/Close

v2:
 Read ADC data from ads7142 using i2c interface
 UART support to control buds
 PM gpio to control either control buds or charging
 HALL sensor to detect lip Open/Close

Device tree nodes

enable-uart-chg-gpios - GPIO to enable uart
enable-lchg-gpios     - GPIO to enable Left charging
enable-rchg-gpios     - GPIO to enable Right Charging

chg-irq-gpios - HALL interrupt pin control


example:
 mmi_earbud_chg {
                compatible = "mmi,earbud_chg";
                pinctrl-names = "chg_active", "chg_suspend";
                pinctrl-0 = <&enable_chg_active &enable_lchg_active &enable_rchg_active>;
                pinctrl-1 = <&enable_chg_suspend &enable_lchg_suspend &enable_rchg_suspend>;
                status = "ok";

                // Need to disable this for charging, Enable for UART communication
                enable-uart-chg-gpios  = <&tlmm 102 0x00>;
                enable-lchg-gpios = <&pmw6100_gpios 3 0>;
                enable-rchg-gpios = <&pmw6100_gpios 5 0>;

                chg-irq-gpios = <&tlmm 121 0x2008>; // HALL sensor interrupt
                interrupt-parent = <&tlmm>;

                mmi,hb-interval = <60000>;
                mmi,t-ichg = <3000>;
        };

ADC config:
        ads7142@18 {
                compatible = "ti,ads7142";
                reg = <0x18>;
                status = "ok";
                channel@0 {
                        reg = <0>;
                };
                channel@1 {
                        reg = <1>;
                };
        };
```

## Kconfig.moto
```kconfig
# SPDX-License-Identifier: GPL-2.0

menu "Moto kernel module Configuration"

source "motorola/kernel/modules/drivers/input/touchscreen/goodix_thp/Kconfig"

source "motorola/kernel/modules/drivers/input/touchscreen/synaptics_tcm2_mmi_v2/Kconfig"

source "motorola/kernel/modules/drivers/input/touchscreen/goodix_berlin_mmi/Kconfig"

source "motorola/kernel/modules/drivers/misc/sarsensor/awinic/aw963xx/Kconfig"

source "motorola/kernel/modules/drivers/misc/sarsensor/semtech/sx937x/Kconfig"

source "motorola/kernel/modules/drivers/moto_swap/Kconfig"

source "motorola/kernel/modules/drivers/power/mmi_glink_charger/Kconfig"

endmenu
```

## drivers/input/touchscreen/goodix_thp/Kconfig
```kconfig
#
# Goodix touchscreen driver configuration
#
menuconfig TOUCHSCREEN_GOODIX_BRL_THP
        tristate "Goodix berlin touchscreen"
        default n
        help
          Say Y here if you have a Goodix berlin touch controller
          to your system.

config THP_FOLD
    bool "Enable thp fold gesture"
    help
      Say Y here if support thp fold gesture

config TOUCHCLASS_MMI_FORCE_ENTER_STANDBY
    bool "Enable force enter standby mode"
    help
      Say Y here if support force enter standby mode

config TOUCHCLASS_MMI_FORCE_ENABLE_GESTURES
    bool "Enable force enable or disable specified gesture mode"
    help
      Say Y here to allow gesture modes, like zero-tap, to be enabled or disabled
      via a special command even when the touch controller is in a suspend/gesture
      state. This is needed to fix issues where gestures are not correctly re-enabled
      after exiting certain power states.
```

## drivers/input/touchscreen/synaptics_tcm2_mmi_v2/Kconfig
```kconfig
# SPDX-License-Identifier: GPL-2.0-only
#
# Synaptics TCM touchscreen driver configuration
#
menuconfig TOUCHSCREEN_SYNA_TCM2
	tristate "Synaptics TCM touchscreen"
	default y
	help
	  Say Y here if you have a Synaptics TCM touchscreen connected.

	  If unsure, say N.

	  To compile this driver as a module, choose M here.

if TOUCHSCREEN_SYNA_TCM2

choice
	default TOUCHSCREEN_SYNA_TCM2_I2C
	prompt "Synaptics TCM bus interface"
config TOUCHSCREEN_SYNA_TCM2_I2C
	bool "I2C"
	depends on I2C
config TOUCHSCREEN_SYNA_TCM2_SPI
	bool "SPI"
	depends on SPI_MASTER
endchoice

config TOUCHSCREEN_SYNA_TCM2_TOUCHCOMM_VERSION_1
	bool "Synaptics TouchComm version 1 interface"
	depends on TOUCHSCREEN_SYNA_TCM2
	help
	  Say Y here to enable support for TouchComm version 1 interface

	  If unsure, say N.

config TOUCHSCREEN_SYNA_TCM2_TOUCHCOMM_VERSION_2
	bool "Synaptics TouchComm version 2 interface"
	depends on TOUCHSCREEN_SYNA_TCM2
	help
	  Say Y here to enable support for TouchComm version 2 interface

	  If unsure, say N.

config TOUCHSCREEN_SYNA_TCM2_SYSFS
	bool "Synaptics TCM device attributes"
	depends on TOUCHSCREEN_SYNA_TCM2
	help
	  Say Y here to enable support for the sysfs interface.

	  If unsure, say N.

config TOUCHSCREEN_SYNA_TCM2_REFLASH
	bool "Synaptics TCM reflash module"
	depends on TOUCHSCREEN_SYNA_TCM2
	help
	  Say Y here to enable support for the reflashing.

	  If unsure, say N.

config TOUCHSCREEN_SYNA_TCM2_TESTING
	bool "Synaptics TCM testing module"
	depends on TOUCHSCREEN_SYNA_TCM2
	help
	  Say Y here to enable support for the production test.

	  If unsure, say N.

config TOUCHSCREEN_SYNA_TCM2_TDDI
	bool "Synaptics TCM TDDI products"
	depends on TOUCHSCREEN_SYNA_TCM2
	help
	  Say Y here to enable support for the TDDI products.

	  If unsure, say N.

config TOUCHSCREEN_SYNA_TCM2_TOUCHCOMM_VERSION_2_LEGACY
	bool "Synaptics legacy TouchComm version 2 firmware"
	depends on TOUCHSCREEN_SYNA_TCM2_TOUCHCOMM_VERSION_2
	help
	  Say Y here to enable support for TouchComm version 2 firmware

	  If unsure, say N.

config TOUCHSCREEN_SYNA_TCM2_DEBUG_MSG
	bool "Enable the debug logs"
	depends on TOUCHSCREEN_SYNA_TCM2
	help
	  Say Y here to enable the logs for debugging.

	  If unsure, say N.

endif
```

## drivers/misc/sarsensor/awinic/aw963xx/Kconfig
```kconfig
#
# awinic sar driver configuration
#

config USE_POWER_SUPPLY_ONLINE
    bool "Enable aw963xx power supply online"
    help
      Say Y here if aw963xx power supply online
      
config CAPSENSE_HALL_CAL
    bool "Enable capsensor cal to detect hall"
    help
      Say Y here if capsensor calbration
```

## drivers/misc/sarsensor/awinic/aw965xx/Kconfig
```kconfig
#
# AWINIC_SAR
#

config AWINIC_SAR
	tristate "Awinic AWINIC_SAR driver"
	depends on I2C
	help
	  Say Y here if you have Awinic AWINIC_SAR controller
	  chip in your system.
	  If unsure, say N.
	  To compile this driver as a module, choose M here: the
	  module will be called  AWINIC_SAR key.

config USE_POWER_SUPPLY_ONLINE
    bool "Enable aw965xx power supply online"
    help
      Say Y here if aw965xx power supply online
      
config CAPSENSE_HALL_CAL
    bool "Enable capsensor cal to detect hall"
    help
      Say Y here if capsensor calbration
```

## drivers/misc/sarsensor/semtech/sx9377_multi/Kconfig
```kconfig
#
# semtech sar driver configuration
#

config CAPSENSE_USB_CAL
    bool "Enable sar sensor recalibration when the USB connection state changes"
    help
      Say Y here if sx9377 usb cali enable

config USE_POWER_SUPPLY_ONLINE
    bool "Enable sx9377 power supply online"
    help
      Say Y here if sx9377 power supply online

config CAPSENSE_HALL_CAL
    bool "Enable capsensor cal to detect hall"
    help
      Say Y here if capsensor calbration

config CAPSENSE_FLIP_CAL
    bool "Enable capsensor cal on flip change"
    help
      Say Y here if sx9377 flip cali enable
```

## drivers/misc/sarsensor/semtech/sx937x/Kconfig
```kconfig
#
# semtech sar driver configuration
#

config CAPSENSE_USB_CAL
    bool "Enable sar sensor recalibration when the USB connection state changes"
    help
      Say Y here if sx937x usb cali enable


config USE_POWER_SUPPLY_ONLINE
    bool "Enable sx937x power supply online"
    help
      Say Y here if sx937x power supply online

config CAPSENSE_HALL_CAL
    bool "Enable capsensor cal to detect hall"
    help
      Say Y here if capsensor calbration
```

## drivers/mm_iosched/Kconfig
```kconfig
# SPDX-License-Identifier: GPL-2.0

config MOTO_IOSCHED
    tristate "io sched"
    default n
    help
      io scheduler
```

## drivers/moto_mmtrack/Kconfig
```kconfig
# SPDX-License-Identifier: GPL-2.0

config MOTO_MMTRACK
    tristate "moto mmtrack"
    default n
    help
      memory tracking module
```

## drivers/moto_reboot_reason/Kconfig
```kconfig
# SPDX-License-Identifier: GPL-2.0

config MOTO_UNKNOWN_REBOOT_DEBUG
	bool "Moto unknown reboot debug"
	default "n"
	help
	  When a reboot/shutdown is not initiated by Moto or init, trigger a crash.
```

## drivers/moto_sched/Kconfig
```kconfig
# SPDX-License-Identifier: GPL-2.0

config MOTO_FUTEX_INHERIT
    tristate "futex inherit"
    default n
    help
      boost futex owner for the blocked ux thread.

config MOTO_RWSEM_INHERIT
    tristate "rwsem inherit"
    default n
    help
      boost rwsem owner for the blocked ux thread.

config MOTO_MUTEX_INHERIT
    tristate "mutex inherit"
    default n
    help
      boost mutex owner for the blocked ux thread.

config MOTO_ENABLE_MDPF
    tristate "Enable moto dynamic performance feature"
    default n
    help
      This feature will allow the scheduler to maintain more detailed
      mvp scheduling of MDPF tasks (uclmap inheritance).
```

## drivers/moto_swap5/Kconfig
```kconfig
# SPDX-License-Identifier: GPL-2.0
config ZRAM_EXT
	bool "Enable ZRAM_EXT"
	default y
	help
	  ZRAM_EXT for per-app swap.
```

## drivers/moto_uimem/Kconfig
```kconfig
# SPDX-License-Identifier: GPL-2.0
config MOTO_UIMEM
	tristate "UI memory page pool"
	help
	  Creates page pool for UI thread of apps.
```

## drivers/power/mmi_glink_charger/Kconfig
```kconfig
#
# mmi_glink_charger driver configuration
#

config MMI_PHONE_CASE_SUPPORT
    bool "Enable phone case support"
    help
      Say Y here if phone case support

config MSC_BQ_PIN_SHORT_PANIC
    bool "Triager kernel panic when BQ PIN_SHORT occur"
    help
      Say Y here if triager panic by BQ_PIN_SHORT
```

## drivers/security/mrkp_test/Kconfig
```kconfig
config MOTO_MRKP_TEST
	tristate "Test MOTO MRKP feature"
	default m
	help
	Test MRKP
```
