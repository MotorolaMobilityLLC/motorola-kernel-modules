## Documentation/devicetree/bindings/input/misc/goodix_fod_mmi/goodix_fod_mmi.txt
```
Goodix Fingerprint TEE driver

Required properties:

-compatible : should be "goodix,fingerprint".
-interrupt-parent : gpio interrupt parent declare
-fp-gpio-irq : irq gpio declare
-fp-gpio-reset : reset gpio declare

Example:

goodix_fp {
        compatible = "goodix,fingerprint";
        status = "okey";
        irq = <&tlmm 48 0>;
        pinctrl-names = "default", "suspend";
        pinctrl-0 = <&ldo_en_active &int_active &rst_active>;
        pinctrl-1 = <&ldo_en_suspend &int_suspend &rst_suspend>;
};
```

## Documentation/devicetree/bindings/input/misc/ti-ads7142/ti,ads7142.yaml
```yaml
# SPDX-License-Identifier: (GPL-2.0-only OR BSD-2-Clause)
%YAML 1.2
---
$id: "http://devicetree.org/schemas/iio/adc/ti,ads7142.yaml#"
$schema: "http://devicetree.org/meta-schemas/core.yaml#"

title: Texas Instruments ADS7142 adc driver device tree bindings

maintainers:
  - József Horváth <info@ministro.hu>

description: |
  This document is for describing the required device tree parameters
   for ads7142 adc
  The required parameters for proper operation are described below.

  Datasheet: https://www.ti.com/lit/ds/symlink/ads7142.pdf

properties:
  compatible:
    const: ti,ads7142

  reg:
    maxItems: 1

  interrupts:
    description: |
      The BUSY/PDY pin is used as interrupt line in autonomous monitoring mode.
    maxItems: 1

  avdd-supply:
    description: Regulator for the reference voltage

  dvdd-supply: true

  "#address-cells":
    const: 1

  "#size-cells":
    const: 0

  "#io-channel-cells":
    const: 1

patternProperties:
  "^channel@[0-1]$":
    $ref: "adc.yaml"
    type: object
    description: |
      Represents the external channels which are connected to the ADC.
    properties:
      reg:
        description: |
          The channel number.
        items:
          minimum: 0
          maximum: 1

    required:
      - reg

    additionalProperties: false

required:
  - compatible
  - "#io-channel-cells"

additionalProperties: false

examples:
  - |
    i2c {
      #address-cells = <1>;
      #size-cells = <0>;
      adc@1f {
        compatible = "ti,ads7142";
        reg = <0x1f>;
        #address-cells = <1>;
        #size-cells = <0>;

        #io-channel-cells = <1>;

        avdd-supply = <&vdd_3v3_reg>;
        dvdd-supply = <&vdd_1v8_reg>;

        interrupt-parent = <&gpio>;
        interrupts = <7 2>;

        channel@0 {
          reg = <0>;
        };

        channel@1 {
          reg = <1>;
        };
      };
    };
...
```

## drivers/input/touchscreen/goodix_gt96x_mmi/Kconfig
```kconfig
#
# Goodix touchscreen driver configuration
#
menuconfig TOUCHSCREEN_GOODIX_BRL
	tristate "Goodix berlin touchscreen"
	help
	  Say Y here if you have a Goodix berlin series touch controller
	  to your system.

	  If build module, say M.
	  If unsure, say N.

if TOUCHSCREEN_GOODIX_BRL

config TOUCHSCREEN_GOODIX_BRL_SPI
	bool "enable SPI connection"
	help
		Say Y here if the touchscreen is connected via SPI bus.

config TOUCHSCREEN_GOODIX_BRL_I2C
	bool "enable I2C connection"
	help
		Say Y here if the touchscreen is connected via I2C bus.

endif
```

## drivers/misc/awinic/haptic_hv_qcom_v1.10.0/Kconfig
```kconfig
#
# Qcom AWINIC_HAPTIC_HV Driver
#

config AWINIC_HAPTIC_HV
	tristate "Awinic high voltage LRA haptic driver"
	depends on I2C
	help
	  Say Y here if you have awinic high voltage haptic chip in your system.
	  If unsure, say N.
	  To compile this driver as a module, choose M here: the
	  module will be called haptic.
```
